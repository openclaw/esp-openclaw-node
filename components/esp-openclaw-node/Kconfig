## components/esp-openclaw-node/Kconfig
```kconfig
menu "ESP OpenClaw Node"

    menu "Registration"

        config ESP_OPENCLAW_NODE_MAX_CAPABILITIES
            int "Maximum registered capabilities"
            range 1 128
            default 16
            help
                Maximum number of capability strings that a single node
                instance can register while idle before the component rejects
                additional capability registrations with ESP_ERR_NO_MEM.

        config ESP_OPENCLAW_NODE_MAX_SCOPES
            int "Maximum registered scopes"
            range 1 32
            default 8
            help
                Maximum number of operator scope strings that one client
                instance can advertise before connecting.

        config ESP_OPENCLAW_NODE_MAX_PENDING_REQUESTS
            int "Maximum pending Gateway requests"
            range 1 32
            default 8
            help
                Maximum number of asynchronous Gateway RPC requests that may
                wait for responses at once.

        config ESP_OPENCLAW_NODE_MAX_COMMANDS
            int "Maximum registered commands"
            range 1 256
            default 32
            help
                Maximum number of commands that a single node instance can
                register while idle before the component rejects additional
                command registrations with ESP_ERR_NO_MEM.

    endmenu

    menu "Runtime"

        config ESP_OPENCLAW_NODE_WORK_QUEUE_LENGTH
            int "Worker queue length"
            range 17 256
            default 32
            help
                Length of the internal FreeRTOS queue used by the component
                worker task to serialize connect, disconnect, transport, and
                protocol work items.

        config ESP_OPENCLAW_NODE_TASK_STACK_SIZE
            int "Worker task stack size"
            range 2048 65536
            default 8192
            help
                Stack size, in bytes, allocated to the component's internal
                worker task created by esp_openclaw_node_create().

        config ESP_OPENCLAW_NODE_TASK_PRIORITY
            int "Worker task priority"
            range 1 24
            default 5
            help
                FreeRTOS priority of the component's internal worker task.
                Raise it above bulk media workloads when node commands must
                stay responsive during audio/video sessions.

    endmenu

    menu "WebSocket Transport"

        config ESP_OPENCLAW_NODE_TRANSPORT_TASK_STACK_SIZE
            int "WebSocket client task stack size"
            range 2048 65536
            default 8192
            help
                Stack size, in bytes, requested for the esp_websocket_client
                task used by the OpenClaw transport.

        config ESP_OPENCLAW_NODE_TRANSPORT_TASK_PRIORITY
            int "WebSocket client task priority"
            range 1 24
            default 5
            help
                FreeRTOS priority of the esp_websocket_client task used by
                the OpenClaw transport. Raise it above bulk media workloads
                when gateway traffic must stay responsive during calls.

        config ESP_OPENCLAW_NODE_TRANSPORT_BUFFER_SIZE
            int "WebSocket transport buffer size"
            range 256 65536
            default 2048
            help
                Buffer size, in bytes, requested for the esp_websocket_client
                transport buffers used by the OpenClaw connection.

        config ESP_OPENCLAW_NODE_MAX_INBOUND_MESSAGE_SIZE
            int "Maximum assembled inbound WebSocket message size"
            range 4096 8388608
            default 2097152
            help
                Maximum size, in bytes, of one assembled inbound text message.
                The transport enforces this cumulatively across TEXT and
                CONTINUATION frames before growing its reassembly buffer.
                Oversize or malformed continuation ordering closes the current
                transport and emits CONNECT_FAILED (during handshake) or
                DISCONNECTED (after ready) with ESP_ERR_INVALID_SIZE.

    endmenu

endmenu
```

## components/esp-openclaw-room-node/Kconfig
```kconfig
menu "OpenClaw room node"

config OPENCLAW_ROOM_WIFI_SSID
    string "Wi-Fi SSID"
    default ""

config OPENCLAW_ROOM_WIFI_PASSWORD
    string "Wi-Fi password"
    default ""

config OPENCLAW_ROOM_SETUP_CODE
    string "Voice-node setup code"
    default ""

config OPENCLAW_ROOM_GATEWAY_HTTP_BASE_URL
    string "Optional Gateway HTTP origin override"
    default ""
    help
        HTTP(S) origin used by Canvas and Talk. Leave empty to derive it from
        the authoritative active/saved ws(s) Gateway URI.

config OPENCLAW_ROOM_TALK_PROVIDER
    string "Optional Talk provider override"
    default ""

config OPENCLAW_ROOM_TALK_MODEL
    string "Optional Talk model override"
    default ""

config OPENCLAW_ROOM_TALK_VOICE
    string "Optional Talk voice override"
    default ""

config OPENCLAW_ROOM_VOICE_ACTIONS
    bool "Request owner access for voice agent actions"
    default n
    help
        Request operator.write and operator.admin in addition to read/talk.
        The Gateway must separately approve owner access. This permits the
        configured agent's owner-only tools, including control of other nodes
        and Gateway administration; access is not limited to one device.
        Prepare a credential with the USB voice-actions commands before
        enabling and flashing this setting. Leave disabled for read-only voice
        access.

config OPENCLAW_ROOM_CALL_IDLE_SECONDS
    int "Maximum call lifetime in seconds"
    range 15 1800
    default 180

endmenu
```

## examples/esp-box-3-display/sdkconfig.defaults
```kconfig
CONFIG_IDF_TARGET="esp32s3"

CONFIG_LOG_DEFAULT_LEVEL_INFO=y
CONFIG_ESP_CONSOLE_USB_SERIAL_JTAG=y
CONFIG_ESP_SYSTEM_PANIC_PRINT_HALT=y

CONFIG_ESP32S3_DATA_CACHE_64KB=y
CONFIG_ESP32S3_DATA_CACHE_LINE_64B=y
CONFIG_ESP32S3_INSTRUCTION_CACHE_32KB=y
CONFIG_SPIRAM=y
CONFIG_SPIRAM_MODE_OCT=y
CONFIG_SPIRAM_SPEED_80M=y

CONFIG_ESPTOOLPY_FLASHMODE_QIO=y
CONFIG_ESPTOOLPY_FLASHSIZE_16MB=y

CONFIG_LV_FONT_MONTSERRAT_16=y
CONFIG_LV_FONT_MONTSERRAT_22=y
CONFIG_LV_MEM_SIZE_KILOBYTES=64
CONFIG_LV_BUILD_EXAMPLES=n
CONFIG_LV_BUILD_DEMOS=n

CONFIG_MBEDTLS_CERTIFICATE_BUNDLE=y
CONFIG_MBEDTLS_CERTIFICATE_BUNDLE_DEFAULT_NONE=y
CONFIG_MBEDTLS_CUSTOM_CERTIFICATE_BUNDLE=y
CONFIG_MBEDTLS_CUSTOM_CERTIFICATE_BUNDLE_PATH="../../certificates/public-roots.pem"
CONFIG_MBEDTLS_SSL_PROTO_TLS1_3=y

# The ESP-BOX-3 BSP stack is substantially larger than the generic examples.
# Use a larger single-app layout on the board's 16 MB flash.
# CONFIG_PARTITION_TABLE_SINGLE_APP is not set
# CONFIG_PARTITION_TABLE_SINGLE_APP_LARGE is not set
CONFIG_PARTITION_TABLE_CUSTOM=y
CONFIG_PARTITION_TABLE_CUSTOM_FILENAME="partitions.csv"

CONFIG_BSP_LCD_DRAW_BUF_HEIGHT=20
```

## examples/esp32-node/sdkconfig.defaults
```kconfig
CONFIG_LOG_DEFAULT_LEVEL_INFO=y
CONFIG_MBEDTLS_CERTIFICATE_BUNDLE=y
CONFIG_MBEDTLS_CERTIFICATE_BUNDLE_DEFAULT_NONE=y
CONFIG_MBEDTLS_CUSTOM_CERTIFICATE_BUNDLE=y
CONFIG_MBEDTLS_CUSTOM_CERTIFICATE_BUNDLE_PATH="../../certificates/public-roots.pem"
CONFIG_MBEDTLS_SSL_PROTO_TLS1_3=y
CONFIG_PARTITION_TABLE_SINGLE_APP_LARGE=y
```

## examples/m5stack-dial-node/sdkconfig.defaults
```kconfig
CONFIG_IDF_TARGET="esp32s3"
CONFIG_ESP_CONSOLE_USB_SERIAL_JTAG=y
CONFIG_ESPTOOLPY_FLASHMODE_QIO=y
CONFIG_ESPTOOLPY_FLASHSIZE_8MB=y
CONFIG_PARTITION_TABLE_CUSTOM=y
CONFIG_PARTITION_TABLE_CUSTOM_FILENAME="partitions.csv"
CONFIG_MBEDTLS_CERTIFICATE_BUNDLE=y
CONFIG_MBEDTLS_CERTIFICATE_BUNDLE_DEFAULT_NONE=y
CONFIG_MBEDTLS_CUSTOM_CERTIFICATE_BUNDLE=y
CONFIG_MBEDTLS_CUSTOM_CERTIFICATE_BUNDLE_PATH="../../certificates/public-roots.pem"
CONFIG_MBEDTLS_SSL_PROTO_TLS1_3=y
CONFIG_LV_FONT_MONTSERRAT_16=y
CONFIG_LV_FONT_MONTSERRAT_20=y
CONFIG_LV_FONT_MONTSERRAT_24=y
CONFIG_LV_MEM_SIZE=49152
CONFIG_LV_BUILD_EXAMPLES=n
CONFIG_LV_BUILD_DEMOS=n
CONFIG_ESP_OPENCLAW_NODE_MAX_INBOUND_MESSAGE_SIZE=32768
```

## examples/m5stack-tab5-room-node/components/tab5_room_board/Kconfig
```kconfig
menu "M5Stack Tab5 room board"

choice OPENCLAW_TAB5_HARDWARE_MODE
    prompt "GPIO20 hardware mode"
    default OPENCLAW_TAB5_USB_HOST

config OPENCLAW_TAB5_USB_HOST
    bool "USB_HOST"

config OPENCLAW_TAB5_RS485
    bool "RS485"

endchoice

config OPENCLAW_TAB5_RS485_BAUD
    int "RS-485 baud rate"
    depends on OPENCLAW_TAB5_RS485
    default 115200
    range 1200 2000000

endmenu
```

## examples/waveshare-esp32-s3-touch-amoled-2.06-room-node/main/Kconfig.projbuild
```kconfig
menu "OpenClaw room node"

config OPENCLAW_ROOM_WIFI_SSID
    string "Wi-Fi SSID"
    default ""

config OPENCLAW_ROOM_WIFI_PASSWORD
    string "Wi-Fi password"
    default ""

config OPENCLAW_ROOM_SETUP_CODE
    string "Voice-node setup code"
    default ""
    help
        Generate with `openclaw qr --voice-node --setup-code-only`. It is used
        only until the node and operator device tokens have been persisted.

config OPENCLAW_ROOM_GATEWAY_HTTP_BASE_URL
    string "Gateway HTTPS origin for relative Talk offers"
    default ""
    help
        HTTPS origin corresponding to the setup code WebSocket endpoint.
        GPT-Live uses this to resolve its Gateway-relative SDP offer URL.
        Leave empty when the configured Talk provider returns an absolute offer
        URL. Plain HTTP exposes the one-use Talk credential and SDP on the LAN;
        use it only for an explicitly trusted, isolated development network.

config OPENCLAW_ROOM_TALK_PROVIDER
    string "Optional Talk provider override"
    default ""

config OPENCLAW_ROOM_TALK_MODEL
    string "Optional Talk model override"
    default ""
    help
        Leave empty to use Gateway Talk configuration. GPT-Live examples are
        gpt-live-1-codex and gpt-live-1-boulder-alpha.

config OPENCLAW_ROOM_TALK_VOICE
    string "Optional Talk voice override"
    default ""

config OPENCLAW_ROOM_CALL_IDLE_SECONDS
    int "Maximum call lifetime in seconds"
    range 15 1800
    default 180

endmenu
```
